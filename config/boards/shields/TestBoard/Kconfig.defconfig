## config/boards/shields/TestBoard/Kconfig.defconfig
```kconfig
if SHIELD_TESTBOARD

# Name must be less than 16 characters long!
    config BOARD
        default "TestBoard"

    config ZMK_KEYBOARD_NAME
        default "TestBoard"


    endif
```
